## components/rogo/wile_common/Kconfig
```kconfig
menu "WILE"
    menu "WILE Configuration"
        config WILE_ENABLE
            bool "Enable WiLe"
            default y

        config DEVICE_NAME
            string "Device product ID"
            default "WILE_DEV"
            depends on WILE_ENABLE
        
        config USE_REPORT_MSG_V1
            bool "Using report state message v1"
            default n
            depends on WILE_ENABLE
    endmenu

endmenu  # WiLe
```

## examples/wile/wile_socket/main/Kconfig.projbuild
```kconfig
menu "Rogo Configuration"

    choice WILE_BOARD
        prompt "Board selection"
        default ESP_WROOM_32 if IDF_TARGET_ESP32
        default ESP32C3_DEV if IDF_TARGET_ESP32C3
        default ESP32S3_DEV if IDF_TARGET_ESP32S3
        help
            Select this option to choose the board for BLE Mesh. The default is ESP32-WROOM-32

        config ESP_WROOM_32
            bool "ESP32-WROOM-32"
            depends on IDF_TARGET_ESP32

        config ESP_WROVER
            bool "ESP32-WROVER"
            depends on IDF_TARGET_ESP32

        config ESP32C3_DEV
            bool "ESP32C3-DevKitC"
            depends on IDF_TARGET_ESP32C3
        
        config ESP32C3_PLUG_RD_FPT
            bool "PLUG-RG-FPT"
            depends on IDF_TARGET_ESP32C3
        
        config ESP32C3_PLUG_RD_TUYA
            bool "PLUG-RG-TUYA"
            depends on IDF_TARGET_ESP32C3
        
        config ESP32C3_PLUG_RD_TUYA3
            bool "PLUG-RG-TUYA-3"
            depends on IDF_TARGET_ESP32C3

        config BESP32S3_DEV
            bool "ESP32S3-DevKitC"
            depends on IDF_TARGET_ESP32S3
        config ESP32C3_PLUG_RD_CHINA
            bool "ESP32C3_PLUG_RD_CHINA"
            depends on IDF_TARGET_ESP32C3
    endchoice

endmenu
```
