## examples/wile/wile_switch/main/Kconfig.projbuild
```kconfig
menu "WiLe device"

    choice WILE_BOARD
        prompt "Board selection"
        default ESP32C3_DEV if IDF_TARGET_ESP32C3
        help
            Select this option to choose the board.

        config ESP32C3_DEV
            bool "ESP32C3-DevKitC"
            depends on IDF_TARGET_ESP32C3

        config ESP32C3_ROGO_DEV
            bool "ESP32C3-Rogo-DevKit"
            depends on IDF_TARGET_ESP32C3

        config ESP32C3_ROGO_SWITCH_3
            bool "ESP32C3-Rogo-Switch-3gang"
            depends on IDF_TARGET_ESP32C3

        config ESP32C6_DEV
            bool "ESP32C6-DevKitC"
            depends on IDF_TARGET_ESP32C6

        config ESP32S3_DEV
            bool "ESP32S3-DevKitC"
            depends on IDF_TARGET_ESP32S3
    endchoice

    menu "Device configuration"      
    endmenu
endmenu
```
